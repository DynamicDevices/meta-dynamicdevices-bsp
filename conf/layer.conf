## wic/imx93-jaguar-eink-large.wks
```
# short-description: Create SD card image with a boot partition for imx93-jaguar-eink
# long-description:
# Create an image that can be written onto a SD card using dd for use
# with i.MX93 Jaguar E-Ink board - with larger root partition
#
# The disk layout used is:
#  - ---------- -------------- --------------
# | | imx-boot |     boot     |    rootfs    |
#  - ---------- -------------- --------------
# ^ ^          ^              ^              ^
# | |          |              |              |
# 0 |        8MiB          264MiB         4GiB (fixed large size)
#   32 32 or 33kiB, see reference manual
#
part u-boot --source rawcopy --sourceparams="file=imx-boot.tagged" --ondisk mmcblk --no-table --align 32
part /boot --source bootimg-partition --ondisk mmcblk --fstype=vfat --label boot --active --align 8192 --fixed-size 256
part / --source rootfs --ondisk mmcblk --fstype=ext4 --label root --align 8192 --fixed-size 4096

# Use GPT partition table for better reliability and to match kernel expectations
# This fixes "GPT: Use GNU Parted to correct GPT errors" warnings
bootloader --ptable gpt
```
