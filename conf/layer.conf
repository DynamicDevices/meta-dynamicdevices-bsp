## conf/machine/imx95-frdm-evk.conf
```bitbake
#@TYPE: Machine
#@NAME: Dynamic Devices FRDM-IMX95 (NXP i.MX95 FRDM EVK)
#@SOC: i.MX95
#@DESCRIPTION: Machine configuration for NXP FRDM-IMX95, based on imx95-15x15-lpddr4x-frdm
#@MAINTAINER: Alex J Lennon <ajlennon@dynamicdevices.co.uk>

MACHINEOVERRIDES =. "imx95-15x15-lpddr4x-frdm:"

require conf/machine/imx95-15x15-lpddr4x-frdm.conf

KMACHINE = "imx95-15x15-lpddr4x-frdm"

# Base DTB from NXP BSP (imx95-15x15-frdm.dtb). Append a custom DTB here when available.
# KERNEL_DEVICETREE:append:imx95-frdm-evk = " freescale/imx95-frdm-evk.dtb"

# FRDM-IMX95 Getting Started guide uses USB serial console on the debug port.
SERIAL_CONSOLES = "115200:ttyUSBConsole"

# OSTree: kernel cmdline (ttyLP0 = SoC UART behind USB debug bridge; see imx93-11x11 LmP default)
OSTREE_KERNEL_ARGS:imx95-frdm-evk ?= "console=tty1 console=ttyLP0,115200 earlycon rootfstype=ext4 rw rootwait loglevel=4 rootflags=noatime"
OSTREE_BOOTLOADER_EXTRA_CONFIG:imx95-frdm-evk = "bootdelay=1"

# No on-board IW612 (MAYA W2 class); keep NXP generic wifi/bluetooth/pcie/sdio from imx95-evk.inc.
# touchscreen + screen: keep from imx-base.inc (display/touch bring-up on FRDM).
MACHINE_FEATURES:remove:imx95-frdm-evk = " nxpiw612-sdio"

# LmP imx9: FSLC+NXP kernel (not generic linux-lmp); see lmp-machine-custom.inc mx93-nxp-bsp
PREFERRED_PROVIDER_virtual/kernel:mx95-nxp-bsp = "linux-lmp-fslc-imx"

# imx9 OP-TEE: NXP-aligned Foundries fork (see lmp-machine-custom.inc imx93 mx93-nxp-bsp)
PREFERRED_VERSION_optee-os-fio:mx95-nxp-bsp = "4.4.0-imx"
PREFERRED_VERSION_optee-os-fio-mfgtool:mx95-nxp-bsp = "4.4.0-imx"
PREFERRED_VERSION_optee-os-tadevkit:mx95-nxp-bsp = "4.4.0-imx"

# meta-lmp lmp-machine-custom / lmp-mfgtool-machine-custom cover imx93 only; mx95 needs
# u-boot-fio + uboot-fitimage so mfgtool-files can deploy u-boot.itb (not u-boot-imx).
IMX_DEFAULT_BOOTLOADER:mx95-generic-bsp ?= "u-boot-fio"
IMX_DEFAULT_BOOTLOADER:mx95-generic-bsp:lmp-mfgtool ?= "u-boot-fio-mfgtool"
PREFERRED_PROVIDER_virtual/bootloader:mx95-nxp-bsp:lmp-mfgtool ?= "u-boot-fio-mfgtool"
IMX_DEFAULT_BOOTLOADER:imx95-frdm-evk:lmp-mfgtool = "u-boot-fio-mfgtool"
PREFERRED_PROVIDER_virtual/bootloader:imx95-frdm-evk:lmp-mfgtool = "u-boot-fio-mfgtool"
# Foundries (sota) boot: u-boot-ostree-scr-fit compiles boot.cmd -> boot.itb on VFAT /boot;
# kernel + DTB are loaded from the OSTree deployment on the rootfs (not from /boot).
# meta-lmp has no mx95 entries, so mirror the proven mx93-generic-bsp sota wiring. The plain
# IMAGE_BOOT_FILES below is for non-sota/local builds; :sota overrides win on Foundries.
# (Target 2707 had only tee.bin + dtb on p1 because boot.itb / WKS_FILE:sota were missing.)
WKS_FILE:sota:imx95-frdm-evk = "emmc-imx-gpt-sota.wks"
IMAGE_BOOT_FILES:mx95-generic-bsp = "${KERNEL_IMAGETYPE} ${@make_dtb_boot_files(d)} boot.scr uEnv.txt"
IMAGE_BOOT_FILES:sota:imx95-frdm-evk = "boot.itb"
IMAGE_BOOT_FILES:mx95-nxp-bsp:lmp-mfgtool = "imx-boot u-boot.itb boot.itb"
KERNEL_IMAGETYPE:sota:mx95-generic-bsp = "fitImage"
KERNEL_CLASSES:sota:mx95-generic-bsp = " kernel-lmp-fitimage "
SOTA_CLIENT_FEATURES:append:mx95-generic-bsp = " ubootenv"
UBOOT_CLASSES:mx95-generic-bsp = "uboot-fitimage"
EXTRA_IMAGEDEPENDS:append:mx95-generic-bsp = " virtual/trusted-firmware-a"
ATF_BINARY:mx95-generic-bsp = "arm-trusted-firmware.bin"
PREFERRED_PROVIDER_virtual/trusted-firmware-a:mx95-nxp-bsp ?= "imx-atf"
UBOOT_ENTRYPOINT:mx95-generic-bsp = "0x80400000"
UBOOT_LOADADDRESS:mx95-generic-bsp = "0x80400000"
UBOOT_DTB_LOADADDRESS:mx95-generic-bsp = "0x83000000"
# U-Boot runtime DTB must match FRDM (not 15x15 EVK adv7535 panel tree — causes
# "invalid device tree", adv7535 probe failures, and mmc0 errors on FRDM).
UBOOT_DTB_NAME:imx95-frdm-evk ?= "imx95-15x15-frdm.dtb"
BOOTSCR_LOAD_ADDR:imx95-frdm-evk = "0x83500000"
UBOOT_SIGN_ENABLE:sota:imx95-frdm-evk ?= "1"
LMP_BOOT_FIRMWARE_FILES:mx95-nxp-bsp = "imx-boot u-boot.itb"
PREFERRED_VERSION_u-boot-fio:mx95-nxp-bsp ?= "imx-2024.04"
PREFERRED_PROVIDER_u-boot-default-script:mx95-generic-bsp = "u-boot-ostree-scr-fit"
PREFERRED_PROVIDER_u-boot-default-script:sota:mx95-generic-bsp = "u-boot-ostree-scr-fit"
PREFERRED_PROVIDER_u-boot-default-script:mx95-generic-bsp:lmp-mfgtool = "u-boot-ostree-scr-fit"
KERNEL_IMAGETYPE:mx95-generic-bsp:lmp-mfgtool = "fitImage"
KERNEL_CLASSES:mx95-generic-bsp:lmp-mfgtool = " kernel-lmp-fitimage "
PREFERRED_VERSION_u-boot-fio-mfgtool:mx95-nxp-bsp ?= "imx-2024.04"
WKS_FILE_DEPENDS:append:mx95-generic-bsp = " u-boot-default-script imx-boot"

# Same imx9-family workarounds as imx93-jaguar-eink (preempt CI failures)
TOOLCHAIN:pn-imx-vpu-hantro = "gcc"
TOOLCHAIN:pn-imx-vpu-hantro-daemon = "gcc"
TOOLCHAIN:pn-nxp-afe = "gcc"
TOOLCHAIN:pn-nxp-afe-voiceseeker = "gcc"
```

## conf/machine/include/cp2108-usb-serial.inc
```bitbake
# Silicon Labs CP2108 USB UART bridge — kernel fragment `cp2108-usb-serial.cfg` from
# linux-lmp-fslc-imx_%.bbappend when MACHINE_FEATURES contains `cp2108-usb-serial`.

MACHINE_FEATURES_BACKFILL_CONSIDERED:append = " cp2108-usb-serial"

# Userspace EEPROM tool (PyUSB); same MACHINE_FEATURES gate as the kernel driver fragment.
# DT510 UART port map vs RS‑232/RS‑485 → docs/DT510-HARDWARE-AUDIT-CHECKLIST.md (CP2108 U13 subsection).
MACHINE_EXTRA_RDEPENDS:append = " \
    ${@bb.utils.contains('MACHINE_FEATURES', 'cp2108-usb-serial', 'cp210x-program', '', d)} \
"
```

## conf/machine/include/lmp-factory-custom.inc
```bitbake
# LMP factory specific customizations (either replace or extend options as defined by meta-lmp)

# kernel modules signing key
MODSIGN_KEY_DIR = "${TOPDIR}/conf/factory-keys"
MODSIGN_PRIVKEY = "${MODSIGN_KEY_DIR}/privkey_modsign.pem"
MODSIGN_X509 = "${MODSIGN_KEY_DIR}/x509_modsign.crt"

# U-Boot signing key
UBOOT_SIGN_KEYDIR = "${TOPDIR}/conf/factory-keys"
UBOOT_SIGN_KEYNAME = "ubootdev"

# OP-TEE TA signing key (factory production). optee-os-fio adds TA_SIGN_KEY to OE make
# when this is non-empty; meta-lmp does not honor OPTEE_TA_SIGN_ENABLE. Unset only for
# LOCAL_DEVELOPMENT_BUILD (KAS/local smoke) so builds without factory-keys/opteedev.key
# succeed. Foundries may set DEV_MODE=1 without LOCAL_DEVELOPMENT_BUILD — keep factory key.
OPTEE_TA_SIGN_KEY = "${@'' if (d.getVar('LOCAL_DEVELOPMENT_BUILD') or '0') == '1' else (d.getVar('TOPDIR') + '/conf/factory-keys/opteedev.key')}"

# SPL / U-Boot proper signing key
UBOOT_SPL_SIGN_KEYDIR = "${TOPDIR}/conf/factory-keys"
UBOOT_SPL_SIGN_KEYNAME = "spldev"

# UEFI keys and certificates
UEFI_SIGN_KEYDIR = "${TOPDIR}/conf/factory-keys/uefi"

# TF-A Trusted Boot
TF_A_SIGN_KEY_PATH = "${TOPDIR}/conf/factory-keys/tf-a/privkey_ec_prime256v1.pem"

# Use custom DTS handling
PREFERRED_PROVIDER_virtual/dtb ?= "lmp-device-tree"

PACKAGECONFIG:append:pn-networkmanager:imx8mm-jaguar-sentai = " modemmanager ppp"
PACKAGECONFIG:append:pn-networkmanager:imx93-jaguar-eink = " modemmanager ppp"

# Support SE050 (disabled for local development builds)
SE05X_OEFID:imx8mm-jaguar-sentai = "0xA1F4"
MACHINE_FEATURES:append:imx8mm-jaguar-sentai = "${@'' if d.getVar('LOCAL_DEVELOPMENT_BUILD') == '1' else ' se05x'}"

SE05X_OEFID:imx8mm-jaguar-inst = "0xA1F4"
MACHINE_FEATURES:append:imx8mm-jaguar-inst = "${@'' if d.getVar('LOCAL_DEVELOPMENT_BUILD') == '1' else ' se05x'}"

# When a new bootloader is used, e.g. moving to a new LMP up-rev here
LMP_BOOT_FIRMWARE_VERSION:imx8mm-jaguar-sentai = "2"
```

## conf/machine/include/mcuboot-pmu-vars.inc
```bitbake
# MCU companion / PMU bootloader (MCUboot-on-Zephyr) — consumed by mcuboot_git.bb + packagegroup-mcuboot.
# Override per-machine in this file only (not in distro).

MCU_PMU_VARIANT ?= "${MACHINE}"
MCUBOOT_BOARD ?= "mcxc444"

# Kconfig basename under recipes-bsp/mcuboot/files/ (see mcuboot_git.bb SRC_URI).
MCU_PMU_KCONFIG ?= "${MCU_PMU_VARIANT}.mcuboot.kconfig"

# Optional Zephyr application package name bundled with FEATURE_mcuboot (empty = omit).
ZEPHYR_PMU_PN:imx93-jaguar-eink ?= "zephyr-mcxc444"
ZEPHYR_PMU_PN:imx8mm-jaguar-dt510 ?= ""
```

## conf/machine/include/mcumgr.inc
```bitbake
# MCUmgr Machine Feature Configuration
# Enables MCUmgr command-line tool for managing Zephyr RTOS devices with MCUboot bootloader
# Specifically designed for boards with dedicated microcontrollers for power management

# Machine feature definition
MACHINE_FEATURES_BACKFILL_CONSIDERED:append = " mcumgr"

# Add MCUmgr package when the machine feature is present
MACHINE_EXTRA_RRECOMMENDS:append = " \
    ${@bb.utils.contains('MACHINE_FEATURES', 'mcumgr', 'mcumgr', '', d)} \
"

# Add useful serial communication tools for MCUmgr
MACHINE_EXTRA_RRECOMMENDS:append = " \
    ${@bb.utils.contains('MACHINE_FEATURES', 'mcumgr', 'screen minicom', '', d)} \
"

# Add development tools when debug features are enabled
MACHINE_EXTRA_RRECOMMENDS:append = " \
    ${@bb.utils.contains_any('MACHINE_FEATURES IMAGE_FEATURES', 'mcumgr debug-tweaks', 'python3-serial python3-pyserial strace', '', d)} \
"

# Configure serial device permissions for mcumgr access
# Add user to dialout group for serial device access
EXTRA_USERS_PARAMS:append = " \
    ${@bb.utils.contains('MACHINE_FEATURES', 'mcumgr', 'groupadd dialout; usermod -a -G dialout root;', '', d)} \
"
```

## conf/machine/include/taa5412.inc
```bitbake
# TI TAA5412-Q1 driver mic @ I2C 0x51 (&sai5) — mutually exclusive driver stacks.
#
#   taa5412 (default on imx8mm-jaguar-dt510)
#     In-kernel snd_soc_pcm6240 backport + firmware-taa5412 regbin
#     (linux-lmp-fslc-imx pcm6240-lmp patches + pcm6240-audio-codec.cfg).
#
#   taa5412-tac5x1x-ti (experimental)
#     TI out-of-tree snd-soc-tac5x1x-taa5412 from git.ti.com lpaa-android-drivers/tac5x1x-linux-driver
#     (recipe kernel-module-tac5x1x-ti-taa5412). OF match is ti,taa5412 only — Lore in-kernel
#     snd-soc-tac5x1x @ 0x50 (MACHINE_FEATURES tac5x1x-audio) is unchanged.
#     Kernel pcm6240 backport disabled via taa5412-pcm6240-disable.cfg.
#
# Switch example (meta-subscriber-overrides/conf/layer.conf or factory subscriber):
#   MACHINE_FEATURES:remove:imx8mm-jaguar-dt510 = " taa5412"
#   MACHINE_FEATURES:append:imx8mm-jaguar-dt510 = " taa5412-tac5x1x-ti"
#
# Do NOT combine with tac5x1x-ti-audio (global TI OOT for cabin loop @ 0x50) — use tac5x1x-audio
# (Lore in-kernel) together with taa5412-tac5x1x-ti for the intended DT510 split-stack layout.

TAA5412_USE_PCM6240 = "${@'1' if bb.utils.contains('MACHINE_FEATURES', 'taa5412', True, False, d) and not bb.utils.contains('MACHINE_FEATURES', 'taa5412-tac5x1x-ti', True, False, d) else '0'}"
TAA5412_USE_TAC5X1X_TI = "${@'1' if bb.utils.contains('MACHINE_FEATURES', 'taa5412-tac5x1x-ti', True, False, d) and not bb.utils.contains('MACHINE_FEATURES', 'taa5412', True, False, d) else '0'}"

MACHINE_EXTRA_RDEPENDS:append = " \
    ${@'firmware-taa5412' if d.getVar('TAA5412_USE_PCM6240') == '1' else ''} \
    ${@'kernel-module-tac5x1x-ti-taa5412' if d.getVar('TAA5412_USE_TAC5X1X_TI') == '1' else ''} \
"

KERNEL_MODULE_AUTOLOAD:append = " \
    ${@' snd-soc-tac5x1x-taa5412' if d.getVar('TAA5412_USE_TAC5X1X_TI') == '1' else ''} \
"

python taa5412_mutual_exclusive () {
    mf = (d.getVar('MACHINE_FEATURES') or '').split()
    if 'taa5412' in mf and 'taa5412-tac5x1x-ti' in mf:
        bb.fatal('MACHINE_FEATURES: use taa5412 (pcm6240 in-kernel) OR taa5412-tac5x1x-ti (TI OOT @ 0x51), not both')
}
```

## conf/machine/include/tac5x1x.inc
```bitbake
# TI TAC5x1x family (e.g. TAC5301-Q1 cabin loop on DT510 &sai6 @ I2C 0x50).
#
# Two mutually exclusive driver stacks — pick ONE per machine image:
#
#   tac5x1x-audio (default on imx8mm-jaguar-dt510)
#     Lore/linux-sound patch series baked into linux-lmp-fslc-imx (MFD + pinctrl + ASoC).
#     See tac5x1x-lmp/tac5x1x-lmp.cfg and linux-lmp-fslc-imx_%.bbappend.
#
#   tac5x1x-ti-audio (experimental)
#     TI out-of-tree snd-soc-tac5x1x from git.ti.com lpaa-android-drivers/tac5x1x-linux-driver
#     (recipe kernel-module-tac5x1x-ti). In-kernel Lore symbols disabled via tac5x1x-lmp-disable-ikernel.cfg.
#     Switch example:
#       MACHINE_FEATURES:remove:imx8mm-jaguar-dt510 = " tac5x1x-audio"
#       MACHINE_FEATURES:append:imx8mm-jaguar-dt510 = " tac5x1x-ti-audio"
#
# Driver mic TAA5412 @ 0x51 is separate — see conf/machine/include/taa5412.inc:
#   taa5412 (default) → pcm6240 in-kernel; taa5412-tac5x1x-ti → snd-soc-tac5x1x-taa5412 OOT @ 0x51 only.
# Do not enable tac5x1x-ti-audio (global TI OOT for cabin loop) on DT510 — use tac5x1x-audio (Lore) +
# taa5412-tac5x1x-ti for the split-stack layout.
#
# Lore / Patchwork tracking (in-kernel path):
#   - Thread: linux-sound, subject "[PATCH v1 0/8] ASoC: support TI's TAC5x1x audio codec family"
#   - yhbt mirror: https://yhbt.net/lore/linux-sound/20260312184833.263-1-niranjan.hy@ti.com/
#
# When the Lore series merges upstream, drop local patches and pin a kernel that
# ships CONFIG_MFD_TAC5X1X / CONFIG_PINCTRL_TI_TAC5X1X / CONFIG_SND_SOC_TAC5X1X.

# bbappend helpers (linux-lmp-fslc-imx_%.bbappend)
TAC5X1X_USE_LORE_IKERNEL = "${@'1' if bb.utils.contains('MACHINE_FEATURES', 'tac5x1x-audio', True, False, d) and not bb.utils.contains('MACHINE_FEATURES', 'tac5x1x-ti-audio', True, False, d) else '0'}"
TAC5X1X_USE_TI_OOT = "${@'1' if bb.utils.contains('MACHINE_FEATURES', 'tac5x1x-ti-audio', True, False, d) else '0'}"

MACHINE_EXTRA_RDEPENDS:append = " \
    ${@'kernel-module-tac5x1x-ti' if d.getVar('TAC5X1X_USE_TI_OOT') == '1' else ''} \
"

KERNEL_MODULE_AUTOLOAD:append = " \
    ${@' snd-soc-tac5x1x' if d.getVar('TAC5X1X_USE_TI_OOT') == '1' else ''} \
"

python tac5x1x_mutual_exclusive () {
    mf = (d.getVar('MACHINE_FEATURES') or '').split()
    if 'tac5x1x-audio' in mf and 'tac5x1x-ti-audio' in mf:
        bb.fatal('MACHINE_FEATURES: use tac5x1x-audio (Lore in-kernel) OR tac5x1x-ti-audio (TI OOT), not both')
}
```

## conf/machine/include/tas2781-mainline.inc
```bitbake
# TAS2781 Mainline Driver Configuration
# This configuration enables the mainline TAS2781 driver with TAS2563 support
# replacing the buggy out-of-tree TI driver

# Machine feature definition
MACHINE_FEATURES_BACKFILL_CONSIDERED:append = " tas2781-mainline"

# TAS2781 driver is built into kernel with TAS2563 support patch
# Remove the old out-of-tree drivers to avoid conflicts and add firmware
MACHINE_EXTRA_RRECOMMENDS:remove = " \
    ${@bb.utils.contains('MACHINE_FEATURES', 'tas2781-mainline', 'kernel-module-tas2781 kernel-module-tas2563', '', d)} \
"

# Add TAS2563 firmware for mainline TAS2781 driver
MACHINE_EXTRA_RRECOMMENDS:append = " \
    ${@bb.utils.contains('MACHINE_FEATURES', 'tas2781-mainline', 'firmware-tas2563', '', d)} \
"

# Ensure proper module loading order
KERNEL_MODULE_PROBECONF:append = " \
    ${@bb.utils.contains('MACHINE_FEATURES', 'tas2781-mainline', 'snd-soc-tas2781-i2c', '', d)} \
"

# Configure TAS2781 module parameters for optimal TAS2563 operation
module_conf_snd-soc-tas2781-i2c = "options snd-soc-tas2781-i2c reset_gpio_active_high=0"
```
