## conf/layer.conf
```bitbake
# Layer configuration for meta-dynamicdevices-bsp
# Board Support Package layer for Dynamic Devices Edge Computing platforms

# Layer identification
BBFILE_COLLECTIONS += "meta-dynamicdevices-bsp"
BBFILE_PATTERN_meta-dynamicdevices-bsp := "^${LAYERDIR}/"
BBFILE_PRIORITY_meta-dynamicdevices-bsp = "12"

# Layer version information
LAYERVERSION_meta-dynamicdevices-bsp = "1"
LAYER_CONF_VERSION ?= "7"

# Layer description and maintainer
LAYERDESCRIPTION_meta-dynamicdevices-bsp = "Board Support Package layer for Dynamic Devices edge computing platforms including i.MX8MM and i.MX93 based boards"
LAYERMAINTAINER_meta-dynamicdevices-bsp = "Dynamic Devices <info@dynamicdevices.co.uk>"

# We might have a conf and classes directory, append to BBPATH
BBPATH .= ":${LAYERDIR}"

# We have a recipes directory, add to BBFILES
BBFILES += "${LAYERDIR}/recipes*/*/*.bb ${LAYERDIR}/recipes*/*/*.bbappend"

# Layer dependencies - BSP layer depends on base layers
# Make meta-lmp-base dependency conditional to allow validation without it
LAYERDEPENDS_meta-dynamicdevices-bsp = "${@'meta-lmp-base' if bb.utils.contains('BBFILE_COLLECTIONS', 'meta-lmp-base', True, False, d) else ''}"
LAYERSERIES_COMPAT_meta-dynamicdevices-bsp = "scarthgap kirkstone"

# This is a BSP layer - it provides machine configurations
# and hardware-specific support for Dynamic Devices platforms

# TI TAA5412 firmware: **`recipes-kernel/firmware/firmware-taa5412_1.0.bb`** installs **`taa5412-i2c-*-1dev.bin`** into **`${nonarch_base_libdir}/firmware`** (`firmware-taa5412` package). **`firmware-taa5412_1.0.bb.disabled`** remains a renamed template reference only — see **`firmware-taa5412/README.bin-provenance.md`**. **`imx8mm-jaguar-dt510`** pulls the package when **`MACHINE_FEATURES`** contains **`taa5412`**.
```

## conf/machine/imx8mm-jaguar-dt510.conf
```bitbake
#@TYPE: Machine
#@NAME: Dynamic Devices i.MX 8M Mini Jaguar DT510 board with LPDDR4
#@SOC: i.MX8MM
#@DESCRIPTION: Machine configuration for Dynamic Devices i.MX 8M Mini Jaguar DT510 board with LPDDR4
#@MAINTAINER: Alex J Lennon  <ajlennon@dynamicdevices.co.uk>

MACHINEOVERRIDES =. "imx8mm-lpddr4-evk:"

require conf/machine/imx8mm-lpddr4-evk.conf
require conf/machine/include/mcuboot-pmu-vars.inc
require conf/machine/include/mcumgr.inc
require conf/machine/include/tas2562.inc
require conf/machine/include/tas2563.inc
require conf/machine/include/ksz9896.inc
require conf/machine/include/cp2108-usb-serial.inc
require conf/machine/include/mcp251xfd-can.inc
require conf/machine/include/tac5x1x.inc

KMACHINE = "imx8mmevk"
# mlan then moal — same order as imx93-jaguar-eink / NXP MOAL README for IW612 SDIO
KERNEL_MODULE_AUTOLOAD:imx8mm-jaguar-dt510 = " i2c-dev spidev snd-aloop mlan moal"

MACHINE_FEATURES:remove:imx8mm-jaguar-dt510 = " nxp8987-sdio"

# Need to remove nxpiw612 to build SDK as for some reason it errors with a conflict with linux-firmware
# TODO: DT510 will use ublox MAYA-W2 WiFi module (IW612 chipset) - same as eink board
# For now using sentai WiFi configuration for demo purposes only - will be updated when new hardware arrives
# STUSB4500 / USB-C PD: not populated on DT510 (hardware; Sentai carries STUSB4500).
# tas6424: Tier C2 class-D on SAI1 — kernel SND_SOC_TAS6424 (see linux-lmp-fslc-imx bbappend)
# bq25792-charger: bq25792-charger.cfg + kernel patches 0010-mfd-bq257xx-*.patch + bq257xx-mfd-kconfig.cfg.
# To disable: MACHINE_FEATURES:remove:imx8mm-jaguar-dt510 = " bq25792-charger"
# cp2108-usb-serial: CONFIG_USB_SERIAL_CP210X — see cp2108-usb-serial.inc.
# To disable: MACHINE_FEATURES:remove:imx8mm-jaguar-dt510 = " cp2108-usb-serial"
# mcp251xfd-can: SocketCAN MCP251xFD — see mcp251xfd-can.inc.
# To disable: MACHINE_FEATURES:remove:imx8mm-jaguar-dt510 = " mcp251xfd-can"
# ksz9896: KSZ9896 DSA switch — CONFIG fragments from imx8mm-jaguar-dt510/ksz9896-*.cfg (see ksz9896.inc).
# To disable: MACHINE_FEATURES:remove:imx8mm-jaguar-dt510 = " ksz9896"
# tas2563: TAS2563 smart amp — tas2562-audio-codec.cfg + tas2781/tas2563 patches + tas2562-driver.cfg (see tas2563.inc).
# To disable: MACHINE_FEATURES:remove:imx8mm-jaguar-dt510 = " tas2563"
# tac5x1x-audio: TAC5x1x lore series + tac5x1x-lmp.cfg — see tac5x1x.inc and tac5x1x-lmp/patches/
# taa5412: TI TAA5412 (`ti,taa5412`) via mainline PCM6240 driver — `pcm6240-lmp/0001-*.patch` + `pcm6240-audio-codec.cfg` (see `linux-lmp-fslc-imx_%.bbappend`).
# To disable: MACHINE_FEATURES:remove:imx8mm-jaguar-dt510 = " taa5412"
# auracast: LE Audio / BAP broadcast host (PipeWire + WirePlumber + BlueZ roles) per NXP UM12155 — `lmp-feature-le-audio.inc`.
#           Requires nxpiw612-sdio (IW612). Enabled on this factory line; to drop LE Audio stack from the image:
# MACHINE_FEATURES:remove:imx8mm-jaguar-dt510 = " auracast"
# dt510-digital-io: board-scripts DIO toggle helpers + pulls libgpiod-tools (see board-scripts_1.0.bb).
# MACHINE_FEATURES:remove:imx8mm-jaguar-dt510 = " dt510-digital-io"
# Optional: also expose DISTRO_FEATURES to recipes that only key on distro flags:
# DISTRO_FEATURES:append:imx8mm-jaguar-dt510 = "${@bb.utils.contains('MACHINE_FEATURES', 'auracast', ' auracast', '', d)}"
# mcuboot: companion PMU MCU (MCUboot in rootfs via lmp-feature-mcuboot / packagegroup-mcuboot).
# imx93 Jaguar E-Ink left mcuboot MACHINE_FEATURE disabled historically (GitHub issue #22 U-Boot SPL size);
# imx8MM DT510 SPL budget may differ — if factory image overflows SPL, revisit this MACHINE_FEATURE.
# mcumgr: MCUmgr CLI on the AP — program the PMU Zephyr app over UART (mcumgr-setup / image upload / reset).
# Distinct from J-Link raw flash of bootloader bins; set /dev/tty* and baud per DT510 hardware SSOT.
MACHINE_FEATURES:append:imx8mm-jaguar-dt510 = " nxpiw612-sdio zigbee tas2563 tas6424 bq25792-charger ksz9896 cp2108-usb-serial mcp251xfd-can tac5x1x-audio taa5412 auracast dt510-digital-io mcuboot mcumgr"

# USB dual UAC2 gadget (simulated / lab path): optional autostart of usb-dual-audio-gadget-dt510.service.
# Enable lab autostart with: MACHINE_FEATURES:append:imx8mm-jaguar-dt510 = " dt510-usb-dual-audio-autostart"
# Scripts stay installed; manual: systemctl start usb-dual-audio-gadget-dt510

#SKIP_RECIPE[linux-firmware] = "linux-firmware is blacklisted"

# NOTE: This is *not* used for the lmp DISTRO / CI. This is just included for local development with lmp-base
KERNEL_DEVICETREE:append:imx8mm-jaguar-dt510 = " imx8mm-jaguar-dt510.dtb"

# Fix imx-vpu-hantro build failure
TOOLCHAIN:pn-imx-vpu-hantro = "gcc"
TOOLCHAIN:pn-imx-vpu-hantro-daemon = "gcc"

# Fix nxp-afe* build failure
TOOLCHAIN:pn-nxp-afe = "gcc"
TOOLCHAIN:pn-nxp-afe-voiceseeker = "gcc"

# Need to have a larger SPI buffer for SPINEL protocol (Zigbee/OpenThread)
KERNEL_MODULE_PROBECONF:append:imx8mm-jaguar-dt510 = " spidev moal"
module_conf_spidev = "options spidev bufsiz=32768"
# MOAL loads IW612 firmware using paths in /lib/firmware/nxp/wifi_mod_para.conf (SDIW612 fw_name).
# Do NOT set fw_name here: firmware-nxp-wifi bbappend toggles .bin vs .bin.se via NXP_WIFI_INSECURE_FIRMWARE;
# a modprobe fw_name that disagrees with the file on disk causes request_firmware to fail even when mlan/moal load.
# For verbose firmware/download logs: drvdbg=2 (then set back to 0 for production).
module_conf_moal = "options moal drvdbg=0"

# Ship SDIO WiFi firmware blobs (IW612). Without this package the rootfs may lack nxp/*.bin[.se] and moal/mlan never attach.
MACHINE_EXTRA_RDEPENDS:append:imx8mm-jaguar-dt510 = " firmware-nxp-wifi-nxpiw612-sdio"
# TAA5412 (PCM6240): driver requests /lib/firmware/taa5412-i2c-1-1dev.bin — vendored blob + recipes-kernel/firmware/firmware-taa5412/.
MACHINE_EXTRA_RDEPENDS:append:imx8mm-jaguar-dt510 = "${@bb.utils.contains('MACHINE_FEATURES', 'taa5412', ' firmware-taa5412', '', d)}"
# dt510-router — NM WAN (lan1) + LAN bridge + DHCP/NAT on br-lan (lan2–lan4). Disabled until re-enabled for field testing.
# MACHINE_EXTRA_RDEPENDS:append:imx8mm-jaguar-dt510 = " dt510-router"

# USB Gadget support - disabled to prevent automatic startup
# MACHINE_EXTRA_RDEPENDS:append:imx8mm-jaguar-dt510 = " usb-composite-gadget"

# Secure boot SE050 into OpTee (disabled for local development builds)
MACHINE_FEATURES:append:imx8mm-jaguar-dt510 = "${@'' if d.getVar('LOCAL_DEVELOPMENT_BUILD') == '1' else ' se05x'}"
# TODO: This line doesn't appear to take effect so overriding it in the OpTee recipe for now
SE05X_OEFID:imx8mm-jaguar-dt510 = "0xA200"

SERIAL_CONSOLES = "115200:ttyUSBConsole"
```

## conf/machine/imx93-jaguar-eink.conf
```bitbake
#@TYPE: Machine
#@NAME: Dynamic Devices i.MX93 Jaguar E-Ink board with LPDDR4X
#@SOC: i.MX93
#@DESCRIPTION: Machine configuration for Dynamic Devices i.MX93 Jaguar E-Ink board with LPDDR4
#@MAINTAINER: Alex J Lennon  <ajlennon@dynamicdevices.co.uk>

MACHINEOVERRIDES =. "imx93-11x11-lpddr4x-evk:"

require conf/machine/imx93-11x11-lpddr4x-evk.conf
require conf/machine/include/mcumgr.inc

KMACHINE = "imx93-11x11-lpddr4x-evk"

KERNEL_MODULE_AUTOLOAD:imx93-jaguar-eink = " spidev"

MACHINE_FEATURES:remove:imx93-jaguar-eink = " nxp8987-sdio"

# IW612 chipset support for ublox MAYA W2 module (WiFi/BT only - no 802.15.4 on this board)
MACHINE_FEATURES:append:imx93-jaguar-eink = " nxpiw612-sdio wifi bluetooth"

# OP-TEE support - REQUIRED for imx93 SoCs (including mfgtool builds)
MACHINE_FEATURES:append:imx93-jaguar-eink = " optee"

# E-Ink display support - Spectra 6 EL133UF1 13.3" display
# TEMPORARILY DISABLED: eink-spectra6 recipe patch failure (Build 2034)
# MACHINE_FEATURES:append:imx93-jaguar-eink = " el133uf1"

# MCXC444 microcontroller support for power management
# Enables MCUboot bootloader and Zephyr RTOS firmware
# TEMPORARILY DISABLED: Causes U-Boot SPL size overflow (see GitHub issue #22)
# MACHINE_FEATURES:append:imx93-jaguar-eink = " mcuboot"

# MCUmgr support for managing the MCXC143VFM power controller
# Enables command-line tool for firmware updates and device management
MACHINE_FEATURES:append:imx93-jaguar-eink = " mcumgr"

# NXP WiFi firmware: Use secured firmware for imx93 with AHAB secure boot
# imx93-jaguar-eink uses AHAB secure boot, so use .se firmware files
# NXP_WIFI_INSECURE_FIRMWARE = "1"  # Disabled for secure boot

#SKIP_RECIPE[linux-firmware] = "linux-firmware is blacklisted"

# NOTE: This is *not* used for the lmp DISTRO / CI. This is just included for local development with lmp-base
KERNEL_DEVICETREE:append:imx93-jaguar-eink = " imx93-jaguar-eink.dtb"

# Fix imx-vpu-hantro build failure
TOOLCHAIN:pn-imx-vpu-hantro = "gcc"
TOOLCHAIN:pn-imx-vpu-hantro-daemon = "gcc"

# Fix nxp-afe* build failure
TOOLCHAIN:pn-nxp-afe = "gcc"
TOOLCHAIN:pn-nxp-afe-voiceseeker = "gcc"

# Need to have a non-default SPI buffer for optimal SPI communication
KERNEL_MODULE_PROBECONF:append:imx93-jaguar-eink = " spidev moal"
module_conf_spidev = "options spidev bufsiz=16384"

# WiFi firmware configuration for MOAL module
# Note: Module parameters work properly for loadable modules (CONFIG_MOAL=m)
# Using secured firmware (.se) as that's what's available on the target
module_conf_moal = "options moal fw_name=nxp/sduart_nw61x_v1.bin.se drvdbg=0"

# E-ink board specific: Remove audio/camera/graphics features, focus on wireless connectivity
# E-Ink displays don't need interactive GUI frameworks or hardware acceleration
MACHINE_FEATURES:remove:imx93-jaguar-eink = " alsa gpu gpu2d gpu3d opencl openvx"

SERIAL_CONSOLES = "115200:ttyUSBConsole"

# === Fast Boot Optimizations ===

# === Power Optimization for 5-Year Battery Life ===
# Priority: Power efficiency over performance for maximum battery life
# NOTE: EdgeLock Enclave enabled for secure functionality
OSTREE_KERNEL_ARGS:imx93-jaguar-eink ?= "console=ttyLP0,115200 rootfstype=ext4 loglevel=1 rw rootwait quiet fastboot initcall_debug=0 nohz=on rcu_nocbs=0-3 isolcpus=nohz,domain,managed_irq,0-3 cpufreq.default_governor=powersave rootflags=noatime,commit=60 kernel.kptr_restrict=1 kernel.dmesg_restrict=1"

# Load essential modules for E-Ink workflow optimization
# WiFi modules loaded automatically for immediate network availability
KERNEL_MODULE_AUTOLOAD:imx93-jaguar-eink = " spidev mlan moal"

# Workflow optimization: WiFi priority, delayed non-essential components
# WiFi built-in for immediate image update capability

# E-Ink display userspace software - handled via machine feature
# MACHINE_EXTRA_RDEPENDS:append:imx93-jaguar-eink = " eink-spectra6"

# Ensure unsecured IW612 WiFi firmware is installed for current unsecured build
MACHINE_EXTRA_RDEPENDS:append:imx93-jaguar-eink = " firmware-nxp-wifi-nxpiw612-sdio"

# Power optimization packages for 5-year battery life
MACHINE_EXTRA_RDEPENDS:append:imx93-jaguar-eink = " wifi-power-management filesystem-optimizations service-optimizations"

# MCXC143VFM power microcontroller setup - configures /dev/ttyLP2 connection on first boot
MACHINE_EXTRA_RDEPENDS:append:imx93-jaguar-eink = " mcxc143-setup"

# E-ink power management CLI tool for MCXC143VFM control
MACHINE_EXTRA_RDEPENDS:append:imx93-jaguar-eink = " eink-power-cli"

# Deep Sleep Mode (DSM) power management - 7.6mW standby power
MACHINE_EXTRA_RDEPENDS:append:imx93-jaguar-eink = " eink-power-management"

# EdgeLock Enclave (ELE) Security Support
# Provides secure boot, key management, and cryptographic services
MACHINE_EXTRA_RDEPENDS:append:imx93-jaguar-eink = " firmware-ele-imx"
# TEMPORARILY DISABLED: nxp-ele-dev-tools - debugging recipe resolution issue
# MACHINE_EXTRA_RDEPENDS:append:imx93-jaguar-eink = " nxp-ele-dev-tools"

# ELE-based Foundries.io LMP Integration
# Provides ELE-based device registration and OTA provisioning
MACHINE_EXTRA_RDEPENDS:append:imx93-jaguar-eink = " lmp-ele-foundries"

# Boot time optimizations
OSTREE_BOOTLOADER_EXTRA_CONFIG:imx93-jaguar-eink = "bootdelay=1"
```

## conf/machine/imx95-15x15-lpddr4x-frdm.conf
```bitbake
#@TYPE: Machine
#@NAME: NXP i.MX 95 15x15 FRDM with LPDDR4x
#@SOC: i.MX95
#@DESCRIPTION: Machine configuration for NXP i.MX 95 15x15 FRDM with LPDDR4x
##@MAINTAINER: Jun Zhu <junzhu@nxp.com>

MACHINEOVERRIDES =. "mx95:"

require conf/machine/include/imx95-evk.inc

KERNEL_DEVICETREE_BASENAME = "imx95-15x15-frdm"

# Hat/overlay DTBs are not in linux-lmp-fslc-imx 6.6.52 yet; add back when DTS land upstream.
KERNEL_DEVICETREE:append:use-nxp-bsp = " \
    freescale/${KERNEL_DEVICETREE_BASENAME}.dtb \
"

# scarthgap meta-imx imx95-evk.inc: UBOOT_CONFIG[sd] = "${BASENAME}_evk_defconfig"
# u-boot-imx lf_v2024.04 (LmP imx95 BSP): imx95_15x15_evk_defconfig only — no FRDM defconfig yet
# (imx95_15x15_frdm_defconfig is in uboot-imx lf_v2025.04+). Kernel/OSTree DTB stays imx95-15x15-frdm.
UBOOT_CONFIG_BASENAME = "imx95_15x15"

IMXBOOT_TARGETS_BASENAME = "flash"

OEI_BOARD  = "mx95lp4x-15"
DDR_TYPE   = "lpddr4x"

# imx-system-manager deploy: imx-sm outputs build/${SYSTEM_MANAGER_CONFIG}/m33_image.bin
SYSTEM_MANAGER_FIRMWARE_BASENAME = "m33_image"
SYSTEM_MANAGER_FIRMWARE_NAME = "${SYSTEM_MANAGER_FIRMWARE_BASENAME}-${SYSTEM_MANAGER_CONFIG}"
DDR_FIRMWARE_NAME = " \
    lpddr4x_dmem_v202409.bin \
    lpddr4x_dmem_qb_v202409.bin \
    lpddr4x_imem_v202409.bin \
    lpddr4x_imem_qb_v202409.bin \
"
OEI_DDR_CONFIG     = "MIMX95_LPDDR4X_EVK_15X15_4000MTS_FW2024.09_timing"
OEI_DDR_CONFIG_ECC = "MIMX95_LPDDR4X_EVK_15X15_4000MTS_FW2024.09_ECC_enabled_timing"

M4_DEFAULT_IMAGE_MX95 = "imx95-15x15-evk_m7_TCM_power_mode_switch.bin"

IMAGE_BOOT_FILES:append = " \
    mcore-demos/imx95-15x15-evk_m7_TCM_hello_world.bin \
    mcore-demos/imx95-15x15-evk_m7_TCM_power_mode_switch.bin \
    mcore-demos/imx95-15x15-evk_m7_TCM_rpmsg_lite_pingpong_rtos_linux_remote.bin \
    mcore-demos/imx95-15x15-evk_m7_TCM_rpmsg_lite_str_echo_rtos.bin \
    mcore-demos/imx95-15x15-evk_m7_TCM_sai_low_power_audio.bin \
"
```
